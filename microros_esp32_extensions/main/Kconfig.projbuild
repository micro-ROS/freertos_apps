## microros_esp32_extensions/main/Kconfig.projbuild
```kconfig
menu "micro-ROS Transport Settings"

menu "UART Settings (for serial transport)"

config MICROROS_UART_TXD
    int "UART TX pin"
    range -1 33
    default -1
    help
        Select Tx Down pin for uart connection or -1 for no change (Only used if serial transport is used for microros).

config MICROROS_UART_RXD
    int "UART RX pin"
    range -1 33
    default -1
    help
        Select Rx Down pin for uart connection or -1 for no change (Only used if serial transport is used for microros).

config MICROROS_UART_RTS
    int "UART RTS pin"
    range -1 33
    default -1
    help
        Select RTS Down pin for uart connection or -1 for no change (Only used if serial transport is used for microros).

config MICROROS_UART_CTS
    int "UART CTS pin"
    range -1 33
    default -1
    help
        Select CTS Down pin for uart connection or -1 for no change (Only used if serial transport is used for microros).

endmenu

menu "WiFi Configuration"

    config ESP_WIFI_SSID
        string "WiFi SSID"
        default "myssid"
        help
            SSID (network name) for the example to connect to.

    config ESP_WIFI_PASSWORD
        string "WiFi Password"
        default "mypassword"
        help
            WiFi password (WPA or WPA2) for the example to use.

    config ESP_MAXIMUM_RETRY
        int "Maximum retry"
        default 5
        help
            Set the Maximum retry to avoid station reconnecting to the AP unlimited when the AP is really inexistent.
endmenu

endmenu


	menu "Camera configuration"

	config OV2640_SUPPORT
		bool "OV2640 Support"
		default y
		help
			Enable this option if you want to use the OV2640.
			Disable this option to save memory.

	config OV7725_SUPPORT
		bool "OV7725 Support"
		default n
		help
			Enable this option if you want to use the OV7725.
			Disable this option to save memory.

	config OV3660_SUPPORT
	    bool "OV3660 Support"
	    default y
	    help
		Enable this option if you want to use the OV3360.
		Disable this option to save memory.

	config OV5640_SUPPORT
	    bool "OV5640 Support"
	    default y
	    help
		Enable this option if you want to use the OV5640.
		Disable this option to save memory.

	config SCCB_HARDWARE_I2C
	    bool "Use hardware I2C for SCCB"
	    default y
	    help
		Enable this option if you want to use hardware I2C to control the camera.
		Disable this option to use software I2C.

	choice SCCB_HARDWARE_I2C_PORT
	    bool "I2C peripheral to use for SCCB"
	    depends on SCCB_HARDWARE_I2C
	    default SCCB_HARDWARE_I2C_PORT1

	    config SCCB_HARDWARE_I2C_PORT0
		bool "I2C0"
	    config SCCB_HARDWARE_I2C_PORT1
		bool "I2C1"

	endchoice

	choice CAMERA_TASK_PINNED_TO_CORE
	    bool "Camera task pinned to core"
	    default CAMERA_CORE0
	    help
		Pin the camera handle task to a certain core(0/1). It can also be done automatically choosing NO_AFFINITY.

	    config CAMERA_CORE0
		bool "CORE0"
	    config CAMERA_CORE1
		bool "CORE1"
	    config CAMERA_NO_AFFINITY
		bool "NO_AFFINITY"

	endchoice
	menu "Camera Pins"
		choice CAMERA_MODEL
		    bool "Select Camera Pinout"
		    default BOARD_WROVER_KIT
		    help
			Select Camera Pinout.

		config BOARD_WROVER_KIT

		    bool "WROVER-KIT OV2640 Module"
		config BOARD_ESP32CAM_AITHINKER

		    bool "ESP32-CAM by AI-Thinker"
		endchoice
	endmenu
    
endmenu
```

## microros_esp32_extensions/sdkconfig.defaults
```kconfig
CONFIG_ESP_MAIN_TASK_STACK_SIZE=25000
CONFIG_FREERTOS_UNICORE=y
CONFIG_ESP_TASK_WDT=n
```
